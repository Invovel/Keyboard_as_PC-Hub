## firmware/body-core/main/Kconfig.projbuild
```kconfig
menu "PC Hub body peripherals"
config BODY_MIC_ENABLE
    bool "Compile INMP441 capture support (unverified hardware)"
    default n
    help
        Reserves I2S1 RX on GPIO4/5/17. Capture starts only from the Mic page.
        This does not expose a USB audio microphone or implement speech recognition.
endmenu
```

## firmware/body-core/sdkconfig.defaults
```kconfig
CONFIG_IDF_TARGET="esp32s3"
CONFIG_ESPTOOLPY_FLASHSIZE_16MB=y
CONFIG_TINYUSB_HID_COUNT=1
CONFIG_TINYUSB_CDC_COUNT=0
CONFIG_ESP_CONSOLE_SECONDARY_NONE=y
CONFIG_USJ_ENABLE_USB_SERIAL_JTAG=n
CONFIG_ESP_LCD_TOUCH_CST816S_DISABLE_READ_ID=y
```
